## components/av_render/Kconfig
```kconfig
menu "AV render diagnostics"

config AV_RENDER_AUDIO_RX_DIAG
    bool "Log downlink audio arrival and output-gap statistics"
    default n
    help
        Diagnostic only. For every five seconds of received audio, log how many
        frames arrived, how often the gap between two arrivals exceeded 40 ms and
        100 ms, the largest such gap, the spread of RTP timestamp steps (a step
        larger than the smallest one means frames never arrived), and the same
        gap statistics for writes to the audio output. The renderer here plays
        frames as they come, with no playout buffer of its own, so an arrival gap
        longer than the output's own buffering is an audible hole.

endmenu
```

## tests/firmware_boot_idf/sdkconfig.defaults
```kconfig
CONFIG_ESP_MAIN_TASK_STACK_SIZE=8192
CONFIG_COMPILER_OPTIMIZATION_ASSERTIONS_ENABLE=y
CONFIG_BOOTLOADER_APP_ROLLBACK_ENABLE=y
CONFIG_PARTITION_TABLE_CUSTOM=y
CONFIG_PARTITION_TABLE_CUSTOM_FILENAME="partitions.csv"
CONFIG_ESPTOOLPY_FLASHSIZE_4MB=y
```
